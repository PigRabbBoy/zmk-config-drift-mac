## boards/shields/drift/Kconfig.defconfig
```kconfig
if SHIELD_DRIFT_CENTRAL_DONGLE

config ZMK_KEYBOARD_NAME
    default "Drift V3 Dongle"

config ZMK_SPLIT_ROLE_CENTRAL
    default y

endif



if ZMK_DISPLAY

config I2C
    default y

config SSD1306
    default y

choice ZMK_DISPLAY_WORK_QUEUE
    default ZMK_DISPLAY_WORK_QUEUE_DEDICATED
endchoice

endif



if LVGL

config LV_Z_VDB_SIZE
    default 64

config LV_DPI_DEF
    default 148

config LV_Z_BITS_PER_PIXEL
    default 1

choice LV_COLOR_DEPTH
    default LV_COLOR_DEPTH_1
endchoice

endif



if SHIELD_DRIFT_LEFT || SHIELD_DRIFT_RIGHT || SHIELD_DRIFT_CENTRAL_DONGLE || SHIELD_DRIFT_LEFT_CENTRAL

config ZMK_SPLIT
    default y

endif
```

## boards/shields/drift/Kconfig.shield
```kconfig
config SHIELD_DRIFT_CENTRAL_DONGLE
    def_bool $(shields_list_contains,drift_central_dongle)
	
config SHIELD_DRIFT_LEFT
    def_bool $(shields_list_contains,drift_left)

config SHIELD_DRIFT_RIGHT
    def_bool $(shields_list_contains,drift_right)
```

## config/west.yml
```yaml
manifest:
  remotes:
    - name: zmkfirmware
      url-base: https://github.com/zmkfirmware
    - name: timception
      url-base: https://github.com/Timception
  projects:
    - name: zmk
      remote: zmkfirmware
      revision: main
      import: app/west.yml
    - name: zmk-behavior-key-press-lip
      remote: timception
      revision: main
  self:
    path: config
```
